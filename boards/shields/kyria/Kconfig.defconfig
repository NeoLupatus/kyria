## boards/shields/kyria/Kconfig.defconfig
```kconfig
if SHIELD_KYRIA_DONGLE

config ZMK_KEYBOARD_NAME
    default "Kyria Dongle"

config ZMK_SPLIT_BLE_ROLE_CENTRAL
	default y

config ZMK_USB
	default y

config ZMK_SPLIT
    default y

config ZMK_BLE
	default y

endif
```

## boards/shields/kyria/Kconfig.shield
```kconfig
# No whitespace after the comma or in the keyboard name!
config KYRIA_DONGLE
    def_bool $(shields_list_contains,kyria_dongle)
```
